## arch/riscv32/soc/riscv-privilege/serv/Kconfig.defconfig.series
```kconfig
if SOC_SERIES_RISCV32_SERV

config COMPILER_OPT
       string
       default "-march=RV32I"

config SOC_SERIES
	string
	default "serv"

config SYS_CLOCK_HW_CYCLES_PER_SEC
	int
	default 16000000

config RISCV_SOC_INTERRUPT_INIT
	bool
	default y

config RISCV_HAS_CPU_IDLE
	bool
	default n

config RISCV_HAS_PLIC
	bool
	default n

#config MULTITHREADING
#       bool
#       default n
config NUM_IRQS
	int
	default 8

config XIP
	bool
	default n

config SERV_TIMER
	bool
	default y

config RISCV_ROM_BASE_ADDR
	hex
	default 0x00000000

config RISCV_ROM_SIZE
	hex
	default 0x10

config RISCV_RAM_BASE_ADDR
	hex
	default	0x00000010

config RISCV_RAM_SIZE
	hex
	default 0x8000



endif # SOC_SERIES_RISCV32_SERV
```

## arch/riscv32/soc/riscv-privilege/serv/Kconfig.series
```kconfig
config SOC_SERIES_RISCV32_SERV
	bool "SERV - SErial RISC-V"
	depends on RISCV32
	select SOC_FAMILY_RISCV_PRIVILEGE
	help
	Enable support for SERV
```

## arch/riscv32/soc/riscv-privilege/serv/Kconfig.soc
```kconfig
choice
prompt "SERV - SErial RISC-V"
depends on SOC_SERIES_RISCV32_SERV

config SOC_RISCV32_SERV
	bool "SERV"
	select ATOMIC_OPERATIONS_C

endchoice
```

## boards/riscv32/service/service_defconfig
```kconfig
CONFIG_RISCV32=y
CONFIG_SOC_RISCV32_SERVANT=y
CONFIG_BOARD_SERVICE=y
CONFIG_CONSOLE=y
CONFIG_SERIAL=y

CONFIG_UART_CONSOLE=y
CONFIG_UART_CONSOLE_ON_DEV_NAME="uart0"
CONFIG_GPIO=y
```

## boards/riscv32/swervolf_nexys/Kconfig.defconfig
```kconfig
if BOARD_SWERVOLF_NEXYS

config BOARD
	default "swervolf_nexys"

config ETH_ETHOC
	default y


endif
```

## boards/riscv32/swervolf_nexys/swervolf_nexys_defconfig
```kconfig
CONFIG_RISCV32=y
CONFIG_SOC_SERIES_RISCV32_SWERV=y
CONFIG_SOC_RISCV32_SWERVOLF=y
CONFIG_BOARD_SWERVOLF_NEXYS=y
CONFIG_CONSOLE=y
CONFIG_SERIAL=y

CONFIG_UART_CONSOLE=y
CONFIG_UART_CONSOLE_ON_DEV_NAME="uart0"
CONFIG_PLIC=n
CONFIG_XIP=n
CONFIG_BOOT_BANNER=y

CONFIG_SPI=y
CONFIG_SPI_NOR=y
CONFIG_SPI_NOR_SECTOR_SIZE=4096
CONFIG_SPI_NOR_PAGE_SIZE=512
```

## drivers/ethernet/Kconfig.ethoc
```kconfig
# Kconfig - ETHOC Ethernet driver configuration options

#
# Copyright (c) 2019 Qamcom
#
# SPDX-License-Identifier: Apache-2.0
#

menuconfig ETH_ETHOC
	bool "Ethoc Ethernet driver"
	help
	  Enable Ethoc Ethernet driver.  Note, this driver performs one shot PHY
	  setup.  There is no support for PHY disconnect, reconnect or
	  configuration change.

if ETH_ETHOC

config ETHOC_BD_TX_NUM
		def_int 16

config ETHOC_BD_RX_NUM
		def_int 24

config ETHOC_CLKFREQ
		def_int 50000000

endif # ETH_ETHOC
```

## drivers/serial/Kconfig.bitbang
```kconfig
menuconfig UART_BITBANG
	bool "SERV bitbang serial driver"
	select SERIAL_HAS_DRIVER
	help
	  This option enables the SERV bitbang serial driver.
	  Hardcoded to send at ~57600 baud rate with a 16MHz clock
```

## drivers/spi/Kconfig.simple_spi
```kconfig
# Kconfig - Simple SPI Driver configuration options

#
# Copyright (c) 2019 Western Digital Corporation or its affiliates
#
# SPDX-License-Identifier: Apache-2.0
#

menuconfig SPI_SIMPLE_SPI
	bool "OpenCores Simple SPI controller driver"
	help
	  Enable the Simple SPI controller

if SPI_SIMPLE_SPI

config SPI_SIMPLE_SPI_BUS_WIDTH
       def_int 8

endif # SPI_SIMPLE_SPI
```

## dts/bindings/ethernet/opencores,ethoc.yaml
```yaml
#
# Copyright (c) 2019
#
# SPDX-License-Identifier: Apache-2.0
#
title: OpenCores Ethoc Ethernet controller
version: 0.1

description: >
     This is a representation of the OpenCores Ethoc ethernet controller.

properties:
    compatible:
      type: string
      category: required
      description: compatible strings
      constraint: "opencores,ethoc"

    reg:
      type: array
      description: mmio register space
      generation: define
      category: required
```

## dts/bindings/interrupt-controller/riscv,pic.yaml
```yaml
#
# Copyright (c) 2019
#
# SPDX-License-Identifier: Apache-2.0
#
---
title: RISC-V PIC
version: 0.1

description: >
    This binding describes the RISC-V Programmable Interrupt Controller

properties:
  compatible:
      category: required
      type: string
      description: compatible strings
      constraint: "riscv,pic"
      generation: define

  reg:
      category: required
      type: int
      description: mmio register space
      generation: define

  riscv,max-priority:
      type: int
      description: maximum interrupt priority
      category: required
      generation: define

"#cells":
  - irq
  - priority
...
```

## dts/bindings/spi/opencores,spi-simple.yaml
```yaml
#
# Copyright (c) 2019, OpenCores Inc.
#
# SPDX-License-Identifier: Apache-2.0
#
---
title: OpenCores Simple SPI driver
version: 0.1

description: >
    This binding gives a base representation of the OpenCores Simple SPI controller

inherits:
    !include spi.yaml

properties:
    compatible:
      type: string
      category: required
      description: compatible strings
      constraint: "opencores,spi-simple"
      generation: define

    reg:
      type: array
      description: mmio register space
      generation: define
      category: required

...
```

## soc/riscv32/servant/Kconfig.defconfig
```kconfig
if SOC_RISCV32_SERVANT

config COMPILER_OPT
	string
	default "-march=rv32i -mabi=ilp32"
config SOC
	string
	default "servant"

config SYS_CLOCK_HW_CYCLES_PER_SEC
	int
	default 16000000

config RISCV_SOC_INTERRUPT_INIT
	bool
	default y

config RISCV_HAS_CPU_IDLE
	bool
	default n

config RISCV_HAS_PLIC
	bool
	default n

config NUM_IRQS
	int
	default 8

config SERV_TIMER
	bool
	default y

config RISCV_ROM_BASE_ADDR
	hex
	default 0x00000000

config RISCV_ROM_SIZE
	hex
	default 0x0

config RISCV_RAM_BASE_ADDR
	hex
	default	0x00000000

config RISCV_RAM_SIZE
	hex
	default 0x8000

if GPIO

config GPIO_MMIO32
	def_bool y

endif # GPIO

if SERIAL

config UART_BITBANG
	def_bool y

endif # SERIAL

endif # SOC_RISCV32_SERVANT
```
